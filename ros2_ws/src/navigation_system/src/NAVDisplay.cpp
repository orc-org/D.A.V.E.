#include <raylib.h>
#include <algorithm>
#include <chrono>
#include <filesystem>
#include <iostream>
#include <memory>
#include <thread>
#include <vector>

#include "Sprite.hpp"
#include "Waypoint.hpp"
#include "Obstacle.hpp"

#include "navigation_interfaces/msg/display_info.hpp"

#include "navigation_interfaces/srv/void_service.hpp"
#include "navigation_interfaces/srv/reset_home.hpp"
#include "navigation_interfaces/srv/select_route.hpp"

#include "navigation_interfaces/srv/add_local_waypoint.hpp"
#include "navigation_interfaces/srv/add_local_waypoint_at_index.hpp"
#include "navigation_interfaces/srv/add_local_obstacle.hpp"

#include "navigation_interfaces/srv/add_geodetic_waypoint.hpp"
#include "navigation_interfaces/srv/add_geodetic_waypoint_at_index.hpp"
#include "navigation_interfaces/srv/add_geodetic_obstacle.hpp"

#include "navigation_interfaces/srv/add_earth_centred_waypoint.hpp"
#include "navigation_interfaces/srv/add_earth_centred_waypoint_at_index.hpp"
#include "navigation_interfaces/srv/add_earth_centred_obstacle.hpp"

#include "navigation_interfaces/srv/remove_local_waypoint.hpp"
#include "navigation_interfaces/srv/remove_geodetic_waypoint.hpp"
#include "navigation_interfaces/srv/remove_earth_centred_waypoint.hpp"
#include "navigation_interfaces/srv/remove_last_waypoint.hpp"

#include "rclcpp/rclcpp.hpp"

using DisplayInfo = navigation_interfaces::msg::DisplayInfo;

using VoidService = navigation_interfaces::srv::VoidService;
using SelectRoute = navigation_interfaces::srv::SelectRoute;
using ResetHome = navigation_interfaces::srv::ResetHome;

using AddLocalWaypoint = navigation_interfaces::srv::AddLocalWaypoint;
using AddLocalWaypointAtIndex = navigation_interfaces::srv::AddLocalWaypointAtIndex;
using AddLocalObstacle = navigation_interfaces::srv::AddLocalObstacle;

using AddGeodeticWaypoint = navigation_interfaces::srv::AddGeodeticWaypoint;
using AddGeodeticWaypointAtIndex = navigation_interfaces::srv::AddGeodeticWaypointAtIndex;
using AddGeodeticObstacle = navigation_interfaces::srv::AddGeodeticObstacle;

using AddEarthCentredWaypoint = navigation_interfaces::srv::AddEarthCentredWaypoint;
using AddEarthCentredWaypointAtIndex = navigation_interfaces::srv::AddEarthCentredWaypointAtIndex;
using AddEarthCentredObstacle = navigation_interfaces::srv::AddEarthCentredObstacle;

using RemoveLocal = navigation_interfaces::srv::RemoveLocalWaypoint;
using RemoveGeodetic = navigation_interfaces::srv::RemoveGeodeticWaypoint;
using RemoveEarthCentred = navigation_interfaces::srv::RemoveEarthCentredWaypoint;
using RemoveLastWaypoint = navigation_interfaces::srv::RemoveLastWaypoint;

using std::placeholders::_1;
using namespace std::chrono_literals;

struct simpleWaypoint{
    int x;
    int y;
    void draw(){
        DrawCircle(x, y, 2, BLUE);
    }
    void drawOnRoute(){
        DrawCircle(x, y, 2, GREEN);
    }
};

struct simpleObstacle{
    int x;
    int y;
    int radius;
    void draw(){
        DrawCircle(x, y, 2, RED);
        DrawCircleLines(x, y, radius, RED);
    }
};


// following code block generated by copilot because I has having trouble finding the path to my textures
namespace {
std::string resolveAssetPath(const std::string& filename)
{
    const std::filesystem::path sourceFile(__FILE__);
    const std::filesystem::path sourceDir = sourceFile.parent_path();
    const std::filesystem::path assetDir = sourceDir.parent_path() / "assets" / "images";

    const std::vector<std::filesystem::path> candidates = {
        assetDir / filename,
        std::filesystem::current_path() / "assets" / "images" / filename,
        std::filesystem::current_path() / filename,
        std::filesystem::path(GetApplicationDirectory()) / "assets" / "images" / filename,
        std::filesystem::path(GetApplicationDirectory()) / filename,
    };

    for (const auto& candidate : candidates) {
        if (std::filesystem::exists(candidate)) {
            return candidate.string();
        }
    }

    return (assetDir / filename).string();
}
}  // namespace

class NAVDisplay : public rclcpp::Node {

private:
    bool resettingHome;

public:

    std::vector<bool> wasAWaypointTheLastPointAdded; // used in the remove last method
    bool editingMode;
    Vector2 currentPosition; // current position of DaVE
    Vector2 nextWaypoint;

    enum coordinates {local, geodetic, earthCentred};  // defines the three coordinate systems available to the pilot
    enum coordinates preference; // used to select which form of the coordinates gets displayed to the pilot

    enum avoidanceStrategy {reroute, trackCrawling, automatic_Circumnavigation_Off}; // defines the methods of circumnavigating obstacles
    enum avoidanceStrategy circumnavigationStyle; // used to select how circumnavigation of obstacles is tackled

    enum preplannedRoute {Route1, Route2, Route3, Route4, Route5}; // defines up to 5 preplanned routes for the operator to select
    enum preplannedRoute routeToFollow; // to allow the operator to select which preplanned route to follow
    enum preplannedRoute routeToEdit;   // to allow the operator to select which preplanned route to edit

    std::vector<simpleWaypoint> waypoints[5];
    std::vector<simpleObstacle> obstacles;

    NAVDisplay() : Node("NAVDisplay") {

        // Create Ros2 Topic Subscribers
        DisplayInfoSubscriber = this->create_subscription<DisplayInfo>("DisplayInfo", 10, std::bind(&NAVDisplay::getInfo, this, _1));

        // Create Ros2 Service Clients
        SelectRouteToFollowClient = this->create_client<SelectRoute> ("SelectRouteToFollow");
        SelectRouteToEditClient   = this->create_client<SelectRoute> ("SelectRouteToEdit");
        ResetHomeClient           = this->create_client<ResetHome>   ("ResetHome");
        ClearRouteClient          = this->create_client<VoidService> ("ClearRoute");

        ToggleDebugClient                 = this->create_client<VoidService> ("ToggleDebug");
        TogglePreferenceClient            = this->create_client<VoidService> ("TogglePreference");
        ToggleRouteToFollowClient         = this->create_client<VoidService> ("ToggleRouteToFollow");
        ToggleRouteToEditClient           = this->create_client<VoidService> ("ToggleRouteToEdit");
        ToggleCircumnavigationStyleClient = this->create_client<VoidService> ("ToggleCircumnavigationStyle");
        ToggleDirectionClient             = this->create_client<VoidService> ("ToggleDirection");

        TargetNextWaypointClient      = this->create_client<VoidService> ("TargetNextWaypoint");
        TargetPreviousWaypointClient  = this->create_client<VoidService> ("TargetPreviousWaypoint");

        AddLocalWaypointClient        = this->create_client<AddLocalWaypoint>        ("AddLocalWaypoint");
        AddLocalWaypointAtIndexClient = this->create_client<AddLocalWaypointAtIndex> ("AddLocalWaypointAtIndex");
        AddLocalObstacleClient        = this->create_client<AddLocalObstacle>        ("AddLocalObstacle");

        RemoveLocalClient         = this->create_client<RemoveLocal> ("RemoveLocal");
        RemoveLocalWaypointClient = this->create_client<RemoveLocal> ("RemoveLocalWaypoint");
        RemoveLocalObstacleClient = this->create_client<RemoveLocal> ("RemoveLocalObstacle");

        RemoveLastWaypointClient = this->create_client<RemoveLastWaypoint> ("RemoveLastWaypoint");
        RemoveLastObstacleClient = this->create_client<RemoveLastWaypoint> ("RemoveLastObstacle");

        std::thread display(&NAVDisplay::mainDisplay, this);
        display.detach();

    }

    void mainDisplay(){
        constexpr int BASE_W = 500;  // aspect ratio horizontal component
        constexpr int BASE_H = 500;   // aspect ratio vertical component

        int nextObstacle_x;
        int nextObstacle_y;

        enum zoomLevels {Half, None, TwoTimes, ThreeTimes, FourTimes};
        enum zoomLevels cameraZoom = None;

        SetConfigFlags(FLAG_WINDOW_RESIZABLE);           // make our window resizeable
        InitWindow(BASE_W, BASE_H, "Navigation System"); // create the window to display our minimap and bearing indicator.
        SetTargetFPS(30);

        Vector2 primaryMonitor = GetMonitorPosition(0); // get the position of the primary monitor
        SetWindowPosition(primaryMonitor.x + GetMonitorWidth(0) * 0.8, primaryMonitor.y + GetMonitorHeight(0) * 0.083); // offset our window by a specific amount when it is initialized

        // Load Textures
        const std::string pathToBackground      = resolveAssetPath("Floor.png");
        const std::string pathToDaVE_texture    = resolveAssetPath("Isometric_DaVE.png");
        const std::string pathToCompass_texture = resolveAssetPath("dual-compass-rose.png");

        Texture2D background      = LoadTexture(pathToBackground.c_str());      // background image for the map, eventually this will be a satelite view of the area
        Texture2D DaVE_texture    = LoadTexture(pathToDaVE_texture.c_str());    // A simple image to be used as a sprite to represent DaVE
        Texture2D compass_texture = LoadTexture(pathToCompass_texture.c_str()); // a simple Rose de Vent to indicate where north is (always up)

        Vector2 origin = {background.width * 0.5f, background.height * 0.5f};

        /*
            the mapping factor is used to deal with converting between pixels on screen and meters in the real world
            the background image can be changed prior to each mission to allow us to use satelite images
            the assumption will be that the picture will be 2km x 2km so as to allow the rover to move up to 1km from the home position
            this mapping factor is used to convert a number of pixels to meters

            (PixelCoordinate - origin) / mappingFactor = LocalCoordinate

            LocalCoordinate * mappingFactor + origin = PixelCoordinate

            *NOTE* the pixel coordinate is the position on the image as measured from the top right corner (hence the -ve sign in the y components of the lambda expressions)
        */
        Vector2 mappingFactor = {background.width / 1000.0f, background.height / 1000.0f};

        auto convertToLocalCordinates = [&](Vector2 pixelPosition)-> Vector2{ 
            return {(pixelPosition.x - origin.x) / mappingFactor.x, -(pixelPosition.y - origin.y) / mappingFactor.y};
        };

        auto convertToPixelCoordinates = [&](Vector2 localPosition)-> Vector2{ 
            return {localPosition.x * mappingFactor.x + origin.x, -localPosition.y * mappingFactor.y + origin.y};
        };

        /*
            A render texture is a surface you can draw on within the window
            we are using one so that we can resize the window while still preserving aspect ratio and
            so that we can segment our main window into a top part for a mini Map and a bottom part for a bearing indicator
        */
        RenderTexture2D map = LoadRenderTexture(BASE_W, BASE_H);

        /*
            we will be implementing our "minimap" by using a full size map and a camera
            we will only render on screen what the camera is aimed at in the full size map
            
            we will be clamping our camera to be within the larger map, to that end we will be using the next values
        */
        float mapWidth   = (float)background.width;
        float mapHeight  = (float)background.height;
        float halfWidth  = BASE_W * 0.5f;
        float halfHeight = BASE_H * 0.5f;

        // create a Sprite object
        Sprite DaVE(&DaVE_texture);
        DaVE.setPosition({400,250});
        DaVE.setRotation(180.0f);
        DaVE.setScale(0.03);

        Sprite Compass(&compass_texture);
        Compass.setPosition({50,50});
        Compass.setRotation(180.0f);
        Compass.setScale(0.2);
        Compass.ReflectHorizontally(true);

        // create Camera
        Camera2D camera = {};
        camera.zoom = 1.0f;
        camera.target = DaVE.getPosition();
        camera.offset = {halfWidth, halfHeight};

        while(!IsKeyDown(KEY_KP_MULTIPLY))
        {
            ///////////////////////////////////////////////////////
            // Navigating mode
            ///////////////////////////////////////////////////////

            if(!editingMode){

                ///////////////////////////////////////////////////////
                // Update Values
                ///////////////////////////////////////////////////////

                // update position Data for DaVE
                //updatePosition();

                // update camera target
                camera.target = DaVE.getPosition();

                // clamp camera to always be within the screen
                camera.target.x = std::clamp(camera.target.x, halfWidth, mapWidth - halfWidth);
                camera.target.y = std::clamp(camera.target.y, halfHeight, mapHeight - halfHeight);
    
                ///////////////////////////////////////////////////////
                // Handle Keyboard inputs
                ///////////////////////////////////////////////////////

                // View CheatSheet
                /*
                    Displays all the keybinds for the NAVDisplay (in your current mode)
                */
                if(IsKeyDown(KEY_F1)){
                    BeginDrawing();
                        ClearBackground(RAYWHITE);
                        DrawText("Enter Editing Mode                          ->      E",               12, 10,  10, BLACK);
                        DrawText("Change Camera Zoom (5 levels)               ->      Z",               12, 30,  10, BLACK);
                        DrawText("Begin Following Next Route                  ->      Up Arrow",        12, 50,  10, BLACK);
                        DrawText("Begin Following Previous Route              ->      Down Arrow",      12, 70,  10, BLACK);
                        DrawText("Begin Following Specific Route              ->      1, 2, 3, 4 or 5", 12, 90,  10, BLACK);
                        DrawText("Toggle Debug                                ->      F2",              12, 110, 10, BLACK);
                        DrawText("Toggle Preference                           ->      F3",              12, 130, 10, BLACK);
                        DrawText("Toggle Direction of Travel                  ->      D",               12, 150, 10, BLACK);
                        DrawText("Manually Target Next Waypoint               ->      Right Arrow",     12, 170, 10, BLACK);
                        DrawText("Manually Target Previous Waypoint           ->      Left Arrow",      12, 190, 10, BLACK);
                        DrawText("Close Window (WARNING: This Is Ireversible) ->      Asterisk",        12, 210, 10, BLACK);
                    EndDrawing();
                    continue;
                }

                // Enter Editing Mode
                if(IsKeyPressed(KEY_E)){
                    editingMode = true;
                    SetWindowPosition(460, 40);
                    SetWindowSize(1000, 1000);
                    continue;
                }

                // toggle Camera Zoom
                if(IsKeyPressed(KEY_Z)){
                    switch(cameraZoom){
                        case Half : {
                            cameraZoom = None;
                            camera.zoom = 1.0f;
                            break;
                        }
                        case None : {
                            cameraZoom = TwoTimes;
                            camera.zoom = 2.0f;
                            break;
                        }
                        case TwoTimes : {
                            cameraZoom = ThreeTimes;
                            camera.zoom = 3.0f;
                            break;
                        }
                        case ThreeTimes : {
                            cameraZoom = FourTimes;
                            camera.zoom = 4.0f;
                            break;
                        }
                        case FourTimes : {
                            cameraZoom = Half;
                            camera.zoom = 0.5f;
                            break;
                        }
                    }
                }

                // Route Selection
                /*
                    up arrow to select the next route
                    down arow to select the previous route
                    1,2,3,4 or 5 to select a specific route
                */
                if(IsKeyPressed(KEY_UP))
                    toggleRouteToEdit();

                else if(IsKeyPressed(KEY_DOWN))
                    if (routeToEdit == 0)
                        selectRouteToEdit(Route5);
                    else
                        selectRouteToEdit(routeToEdit - 1);

                else if (IsKeyPressed(KEY_KP_1) || IsKeyPressed(KEY_ONE))
                    selectRouteToFollow(Route1);

                else if (IsKeyPressed(KEY_KP_2) || IsKeyPressed(KEY_TWO))
                    selectRouteToFollow(Route2);

                else if (IsKeyPressed(KEY_KP_3) || IsKeyPressed(KEY_THREE))
                    selectRouteToFollow(Route3);

                else if (IsKeyPressed(KEY_KP_4) || IsKeyPressed(KEY_FOUR))
                    selectRouteToFollow(Route4);

                else if (IsKeyPressed(KEY_KP_5) || IsKeyPressed(KEY_FIVE))
                    selectRouteToFollow(Route5);

                // Toggle Debug
                if(IsKeyPressed(KEY_F2))
                    toggleDebug();
                
                // Toggle Preference
                if(IsKeyPressed(KEY_F3))
                    togglePreference();

                // Toggle Direction
                if(IsKeyPressed(KEY_D))
                    toggleDirection();

                // Manual Selection Of Next Waypoint
                /*
                    used to manually select which waypoint to follow
                    this is a fail safe for if the NAV node doesn't detect that you've reached a waypoint and thus must move onto the next one

                    "Better to have it and not need it, than need it and not have it" - Rick Yansey
                */
                if(IsKeyPressed(KEY_LEFT))
                    goToNextWaypoint();
                else if(IsKeyPressed(KEY_RIGHT))
                    goToPreviousWaypoint();



                ///////////////////////////////////////////////////////
                // Render Frame
                ///////////////////////////////////////////////////////

                BeginTextureMode(map); // start drawing onto the map
                    ClearBackground(WHITE); // ensure we are starting with a blank canvas

                    BeginMode2D(camera); // Render only what is visible to the camera
                        DrawTexture(background, 0, 0, WHITE);
                        drawObstacles();
                        drawWaypoints();
                    EndMode2D();
                EndTextureMode();

            // figure out scaling to fix a resized window
            float scale = std::min(
                (float)GetScreenWidth() / BASE_W,
                (float)GetScreenHeight()/ BASE_H
            );

            /*
                * We'll be using the "black bars" approach to preserve the aspect ratio when resizing
                * When the x scaling and the y scaling factors are not the same, we will make up the difference
                * with a solid black bar
                * this is why we need an offset
                *
                * NOTE: by "black bars" I actually mean white ones
                * this is because the compass markings are black
                */

            float offsetX = (GetScreenWidth() - BASE_W * scale) * 0.5f;
            float offsetY = (GetScreenHeight() - BASE_H * scale) * 0.5f;

            Rectangle src  = { 0, 0, (float)BASE_W, -(float)BASE_H};
            Rectangle dest = { offsetX, offsetY, BASE_W * scale, BASE_H * scale};

            BeginDrawing();
                ClearBackground(GRAY);
                DrawTexturePro(map.texture, src, dest, {0,0}, 0.0f, WHITE);

            EndDrawing();
            }

            ///////////////////////////////////////////////////
            // Editing Mode
            ///////////////////////////////////////////////////

            else {
                ///////////////////////////////////////////////////////
                // Update Values
                ///////////////////////////////////////////////////////


                ////////////////////////////////////////////////////////
                // Handle Keyboard Input
                ////////////////////////////////////////////////////////

                // View CheatSheet
                /*
                    Displays all the keybinds for the NAVDisplay (in your current mode)
                */
                if(IsKeyDown(KEY_F1)){
                    BeginDrawing();
                        ClearBackground(RAYWHITE);
                        DrawText("Add Waypoint ------------------------ Left Click",                                      12, 10,  10, BLACK);
                        DrawText("Revove Waypoint --------------------- Shift + Left Click",                              12, 30,  10, BLACK);
                        DrawText("Add Obstacle ------------------------ Right Click + Drag to set radius",                12, 50,  10, BLACK);
                        DrawText("Revove Obstacle --------------------- Shift + Right Click",                             12, 70,  10, BLACK);
                        DrawText("Revove Last Obstacle/Waypoint ------- Backspace",                                       12, 90,  10, BLACK);
                        DrawText("Edit Next Route --------------------- Up Arrow",                                        12, 110, 10, BLACK);
                        DrawText("Edit Previous Route ----------------- Down Arrow",                                      12, 130, 10, BLACK);
                        DrawText("Select Route To Edit ---------------- 1, 2, 3, 4 or 5",                                 12, 150, 10, BLACK);
                        DrawText("Reset Home To Next Waypoint --------- H + O + M + E, then place a waypoint like usual", 12, 170, 10, BLACK);
                        DrawText("Clear Current Route ----------------- K + I + L",                                       12, 190, 10, BLACK);
                        DrawText("Exit Editing Mode ------------------- Enter",                                           12, 210, 10, BLACK);
                    EndDrawing();
                    continue;
                }

                // Exiting Editng Mode
                if(IsKeyPressed(KEY_ENTER)){
                    editingMode = false;
                    SetWindowPosition(primaryMonitor.x + GetMonitorWidth(0) * 0.8, primaryMonitor.y + GetMonitorHeight(0) * 0.083);
                    SetWindowSize(500, 500);
                    continue;
                }

                // Adding / Removing waypoints and obstacles
                /*
                    left click to place waypoint
                    right click to place obstacle (click and drag to set radius)

                    left shift + left click to remove waypoint
                    left shift + right click to remove obstacle
                    backspace to remove the last waypoint/obstacle
                */
                if(IsMouseButtonPressed(MOUSE_BUTTON_LEFT) && IsKeyDown(KEY_LEFT_SHIFT)){
                    Vector2 position = convertToLocalCordinates({GetMouseX(), GetMouseY()});
                    removeLocalWaypoint(position.x, position.y); // remove actual waypoint in the NAVnode
                    removeWaypoint(GetMouseX(), GetMouseY()); // remove simple obstacle from the display
                }
                else if(IsMouseButtonPressed(MOUSE_BUTTON_RIGHT) && IsKeyDown(KEY_LEFT_SHIFT)){
                    Vector2 position = convertToLocalCordinates({GetMouseX(), GetMouseY()});
                    removeLocalObstacle(position.x, position.y);
                    removeObstacle(GetMouseX(), GetMouseY());
                } 
                else if(IsKeyPressed(KEY_BACKSPACE)){
                        removeLast();
                }
                else if(IsMouseButtonPressed(MOUSE_BUTTON_LEFT)){
                    Vector2 position = convertToLocalCordinates({GetMouseX(), GetMouseY()});
                    if(resettingHome){
                        resettingHome = false;
                        resetHome(position.x, position.y);
                    }
                    else{
                        addWaypoint(GetMouseX(), GetMouseY());    // add simple waypoint on display side
                        addLocalWaypoint(position.x, position.y); // add actual waypoint on NAVnode side
                    }
                }
                else if(IsMouseButtonPressed(MOUSE_BUTTON_RIGHT)){
                    nextObstacle_x = GetMouseX();
                    nextObstacle_y = GetMouseY();
                }
                else if(IsMouseButtonReleased(MOUSE_BUTTON_RIGHT)){
                    int dx = nextObstacle_x - GetMouseX();
                    int dy = nextObstacle_y - GetMouseY();                
                    int radius = std::sqrt(dx * dx + dy * dy);

                    if (radius / mappingFactor.x < 1){
                        addObstacle(nextObstacle_x, nextObstacle_y, Obstacle::defaultRadius * mappingFactor.x); // add simple obstacle on the display side with default radius
                        Vector2 position = convertToLocalCordinates({nextObstacle_x, nextObstacle_y});
                        addLocalObstacle(position.x, position.y, mappingFactor); // add actual obstacle on the NAVnode side with defaut radius
                    }
                    else{
                        addObstacle(nextObstacle_x, nextObstacle_y, radius); // add simple obstacle on the display side
                        Vector2 position = convertToLocalCordinates({nextObstacle_x, nextObstacle_y});
                        addLocalObstacle(position.x, position.y, radius / mappingFactor.x); // add actual obstacle on the NAVnode side
                    }
                }
                

                // Route Selection
                /*
                    up arrow to select the next route
                    down arrow to select the previous route
                    1,2,3,4 or 5 to set a specific route
                */
                if(IsKeyPressed(KEY_UP))
                    toggleRouteToEdit();

                else if(IsKeyPressed(KEY_DOWN))
                    if (routeToEdit == 0)
                        selectRouteToEdit(Route5);
                    else
                        selectRouteToEdit(routeToEdit - 1);

                else if (IsKeyPressed(KEY_KP_1) || IsKeyPressed(KEY_ONE))
                    selectRouteToFollow(Route1);

                else if (IsKeyPressed(KEY_KP_2) || IsKeyPressed(KEY_TWO))
                    selectRouteToFollow(Route2);

                else if (IsKeyPressed(KEY_KP_3) || IsKeyPressed(KEY_THREE))
                    selectRouteToFollow(Route3);

                else if (IsKeyPressed(KEY_KP_4) || IsKeyPressed(KEY_FOUR))
                    selectRouteToFollow(Route4);

                else if (IsKeyPressed(KEY_KP_5) || IsKeyPressed(KEY_FIVE))
                    selectRouteToFollow(Route5);

                // resetHome
                /*
                    after indicating that you wish to reset the home location, the next waypoint that you place will become the new home location
                */
                if(IsKeyPressed(KEY_H) && IsKeyPressed(KEY_O) && IsKeyPressed(KEY_M) && IsKeyPressed(KEY_E))
                    resettingHome = true;

                // clear Route
                if(IsKeyPressed(KEY_K) && IsKeyPressed(KEY_I) && IsKeyPressed(KEY_L))
                    clearRoute();

                ///////////////////////////////////////////////////////
                // Render Frame
                ///////////////////////////////////////////////////////

                BeginDrawing();
                    ClearBackground(GRAY);
                    
                    // Draw Map
                    DrawTexture(background, 0, 0, WHITE);
                    drawObstacles();
                    drawWaypoints();
                    
                    // Draw Text Ribbon
                    DrawRectangle(0, BASE_H - 32, BASE_W, 32, ColorAlpha(RAYWHITE, 0.6f));
                    DrawText(TextFormat("Mouse: %.0f,%.0f", GetMouseX(), GetMouseY()), 12, BASE_H - 24, 20, BLACK);
                    DrawText(TextFormat("Route: %.0d", routeToEdit - 1), 256, BASE_H - 24, 20, BLACK);

                EndDrawing();
            }
        }

        UnloadTexture(background);
        UnloadTexture(DaVE_texture);
        UnloadTexture(compass_texture);
        UnloadRenderTexture(map);

        CloseWindow();
    }

    void drawWaypoints(){
        for(int i = 0; i < 5; i++){
            if(waypoints[i].size() == 0) 
                continue;
            else if(i == routeToFollow) {
                waypoints[routeToFollow][0].drawOnRoute();
                for(unsigned int j = 1; j < waypoints[routeToFollow].size(); j++){
                    waypoints[routeToFollow][j].drawOnRoute();
                    DrawLine(waypoints[routeToFollow][j - 1].x, waypoints[routeToFollow][j - 1].y, 
                        waypoints[routeToFollow][j].x, waypoints[routeToFollow][j].y, GREEN);
                }
            }
            else
                for(simpleWaypoint point : waypoints[i])
                    point.draw();
        }
        DrawCircle(nextWaypoint.x, nextWaypoint.y, 6, ORANGE);
    }

    void drawObstacles(){
        for(simpleObstacle thing : obstacles)
            thing.draw();
    }

    void addWaypoint(int x, int y){
        waypoints[routeToEdit].push_back({x, y});
    }

    void addObstacle(int x, int y, int radius){
        obstacles.push_back({x, y, radius});
    }

    void removeWaypoint(int x, int y){
        std::vector<simpleWaypoint>::iterator it;

        for(it = waypoints[routeToEdit].begin(); it != waypoints[routeToEdit].end(); ++it){
            if (it->x == x && it->y == y){
                waypoints[routeToEdit].erase(it);
                break;
            }
        }
    }

    void removeObstacle(int x, int y){
        std::vector<simpleObstacle>::iterator it;

        for(it = obstacles.begin(); it != obstacles.end(); ++it){
            if (it->x == x && it->y == y){
                obstacles.erase(it);
                break;
            }
        }
    }

    void getInfo(const DisplayInfo &data){
        currentPosition.x = data.local_x;
        currentPosition.y = data.local_y;
        nextWaypoint.x = data.waypoint_local_x;
        nextWaypoint.y = data.waypoint_local_y;
        

        switch(data.route2follow){
            case data.ROUTE1 : routeToFollow = Route1; break;
            case data.ROUTE2 : routeToFollow = Route2; break;
            case data.ROUTE3 : routeToFollow = Route3; break;
            case data.ROUTE4 : routeToFollow = Route4; break;
            case data.ROUTE5 : routeToFollow = Route5; break;
        }

        switch(data.route2edit){
            case data.ROUTE1 : routeToEdit = Route1; break;
            case data.ROUTE2 : routeToEdit = Route2; break;
            case data.ROUTE3 : routeToEdit = Route3; break;
            case data.ROUTE4 : routeToEdit = Route4; break;
            case data.ROUTE5 : routeToEdit = Route5; break;
        }

        switch(data.preference){
            case data.LOCAL : preference = local; break;
            case data.GEODETIC : preference = geodetic; break;
            case data.EARTH_CENTRED : preference = earthCentred; break;
        }
    }

    void goToNextWaypoint(){

    }

    void goToPreviousWaypoint(){

    }

    void clearRoute(){
        auto request = std::make_shared<VoidService::Request>();

        ClearRouteClient->async_send_request(request);
    }

    void resetHome_response(rclcpp::Client<ResetHome>::SharedFuture future){
        auto response = future.get();

        if (response->success)
            std::cout << "Home successfully reset" << '\n';
        else
            std::cout << "Home Reset Failed" << '\n';
    }

    void resetHome(int x, int y){
        auto request = std::make_shared<ResetHome::Request>();
        auto geodeticPosition = Waypoint::local_To_GeodeticApprox(x, y);
        request->latitude = geodeticPosition[0];
        request->longitude = geodeticPosition[1];
        request->password = 741021;

        ResetHomeClient->async_send_request(request, std::bind(&NAVDisplay::resetHome_response, this, _1));
    }

    void toggleDebug(){
        auto request = std::make_shared<VoidService::Request>();

        ToggleDebugClient->async_send_request(request);
    }

    void toggleRouteToFollow(){
        auto request = std::make_shared<VoidService::Request>();

        ToggleRouteToFollowClient->async_send_request(request);
    }

    void toggleRouteToEdit(){
        auto request = std::make_shared<VoidService::Request>();

        ToggleRouteToEditClient->async_send_request(request);
    }

    void selectRouteToFollow(int route){
        auto request = std::make_shared<SelectRoute::Request>();
        request->route = --route;

        SelectRouteToFollowClient->async_send_request(request);
    }

    void selectRouteToEdit(int route){
        auto request = std::make_shared<SelectRoute::Request>();
        request->route = --route;

        SelectRouteToEditClient->async_send_request(request);
    }

    void togglePreference(){
        auto request = std::make_shared<VoidService::Request>();

        TogglePreferenceClient->async_send_request(request);
    }

    void toggleCircumnavigationStyle(){
        auto request = std::make_shared<VoidService::Request>();

        ToggleCircumnavigationStyleClient->async_send_request(request);
    }

    void toggleDirection(){
        auto request = std::make_shared<VoidService::Request>();

        ToggleDirectionClient->async_send_request(request);
    }

    void targetNextWaypoint(){
        auto request = std::make_shared<VoidService::Request>();

        TargetNextWaypointClient->async_send_request(request);
    }

    void targetPreviousWaypoint(){
        auto request = std::make_shared<VoidService::Request>();

        TargetPreviousWaypointClient->async_send_request(request);
    }

    void addLocalWaypoint(int x, int y){
        auto request = std::make_shared<AddLocalWaypoint::Request>();
        request->x = x;
        request->y = y;

        wasAWaypointTheLastPointAdded.push_back(true);

        AddLocalWaypointClient->async_send_request(request); 
    }

    void addLocalObstacle(int x, int y, int radius){
        auto request = std::make_shared<AddLocalObstacle::Request>();
        request->x = x;
        request->y = y;
        request->radius = radius;

        wasAWaypointTheLastPointAdded.push_back(false);

        AddLocalObstacleClient->async_send_request(request); 
    }

    void addLocalObstacle(int x, int y, Vector2 mappingFactor){
        auto request = std::make_shared<AddLocalObstacle::Request>();
        request->x = x;
        request->y = y;
        request->radius = -1;

        wasAWaypointTheLastPointAdded.push_back(false);

        AddLocalObstacleClient->async_send_request(request); 
    }

    void removeLocalWaypoint_response(rclcpp::Client<RemoveLocal>::SharedFuture future){
        auto response = future.get();

        std::cout << response->output << 'n';
    }

    void removeLocalWaypoint(int x, int y){
        auto request = std::make_shared<RemoveLocal::Request>();
        request->x = x;
        request->y = y;

        RemoveLocalWaypointClient->async_send_request(request, std::bind(&NAVDisplay::removeLocalWaypoint_response, this,_1));
    }


    void removeLocalObstacle_response(rclcpp::Client<RemoveLocal>::SharedFuture future){
        auto response = future.get();

        std::cout << response->output << 'n';
    }

    void removeLocalObstacle(int x, int y){
        auto request = std::make_shared<RemoveLocal::Request>();
        request->x = x;
        request->y = y;

        RemoveLocalObstacleClient->async_send_request(request, std::bind(&NAVDisplay::removeLocalWaypoint_response, this,_1));
    }

    void removeLocal_response(rclcpp::Client<RemoveLocal>::SharedFuture future){
        auto response = future.get();

        std::cout << response->output << 'n';
    }

    void removeLocal(int x, int y){
        auto request = std::make_shared<RemoveLocal::Request>();
        request->x = x;
        request->y = y;

        RemoveLocalClient->async_send_request(request, std::bind(&NAVDisplay::removeLocalWaypoint_response, this,_1));
    }

    void removeLast_response(rclcpp::Client<RemoveLastWaypoint>::SharedFuture future){
        auto response = future.get();

        std::cout << response->output << 'n';
    }

    void removeLast(){
        auto request = std::make_shared<RemoveLastWaypoint::Request>();

        if (!wasAWaypointTheLastPointAdded.back()){
            RemoveLastObstacleClient->async_send_request(request, std::bind(&NAVDisplay::removeLast_response, this,_1));
            obstacles.pop_back();
        }
        else{
            RemoveLastWaypointClient->async_send_request(request, std::bind(&NAVDisplay::removeLast_response, this,_1));
            waypoints[routeToEdit].pop_back();
        }
        
        wasAWaypointTheLastPointAdded.pop_back();
    }

    // Topic definitions
    rclcpp::Subscription<DisplayInfo>::SharedPtr DisplayInfoSubscriber;

    // Service Client Definitions
    rclcpp::Client<SelectRoute>::SharedPtr SelectRouteToFollowClient;
    rclcpp::Client<SelectRoute>::SharedPtr SelectRouteToEditClient;
    rclcpp::Client<ResetHome>::SharedPtr   ResetHomeClient;
    rclcpp::Client<VoidService>::SharedPtr ClearRouteClient;

    rclcpp::Client<VoidService>::SharedPtr ToggleDebugClient;
    rclcpp::Client<VoidService>::SharedPtr TogglePreferenceClient;
    rclcpp::Client<VoidService>::SharedPtr ToggleRouteToFollowClient;
    rclcpp::Client<VoidService>::SharedPtr ToggleRouteToEditClient;
    rclcpp::Client<VoidService>::SharedPtr ToggleCircumnavigationStyleClient;
    rclcpp::Client<VoidService>::SharedPtr ToggleDirectionClient;

    rclcpp::Client<VoidService>::SharedPtr TargetNextWaypointClient;
    rclcpp::Client<VoidService>::SharedPtr TargetPreviousWaypointClient;


    rclcpp::Client<AddLocalWaypoint>::SharedPtr AddLocalWaypointClient;
    rclcpp::Client<AddLocalWaypointAtIndex>::SharedPtr AddLocalWaypointAtIndexClient;
    rclcpp::Client<AddLocalObstacle>::SharedPtr AddLocalObstacleClient;

    rclcpp::Client<RemoveLocal>::SharedPtr RemoveLocalClient;
    rclcpp::Client<RemoveLocal>::SharedPtr RemoveLocalWaypointClient;
    rclcpp::Client<RemoveLocal>::SharedPtr RemoveLocalObstacleClient;

    rclcpp::Client<RemoveLastWaypoint>::SharedPtr RemoveLastWaypointClient;
    rclcpp::Client<RemoveLastWaypoint>::SharedPtr RemoveLastObstacleClient;

};




int main(int argc, char** argv) {
    (void)argc;
    (void)argv;

    rclcpp::init(argc, argv);
    rclcpp::spin(std::make_shared<NAVDisplay>());
    rclcpp::shutdown();
    return 0;
}